## conf/layer.conf
```bitbake
# We have a conf and classes directory, add to BBPATH
BBPATH .= ":${LAYERDIR}"

# We have recipes-* directories, add to BBFILES
BBFILES += "${LAYERDIR}/recipes-*/*/*.bb \
            ${LAYERDIR}/recipes-*/*/*.bbappend"

BBFILE_COLLECTIONS += "meta-dht11Nginx"
BBFILE_PATTERN_meta-dht11Nginx = "^${LAYERDIR}/"
BBFILE_PRIORITY_meta-dht11Nginx = "6"

LAYERDEPENDS_meta-dht11Nginx = "core"
LAYERSERIES_COMPAT_meta-dht11Nginx = "scarthgap"
```
